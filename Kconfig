## Kconfig
```kconfig
mainmenu "Radar Configuration"

config RADAR
    bool "Radar config"
    default n

source "components/Kconfig"
```

## components/Kconfig
```kconfig
menu "components"

config ENABLE_FSMOMC
    bool "using FSMOMC framework"
    default n

config ENABLE_CM_BACKTRACE
    bool "using cm_backtrace"
    default n

config ENABLE_EASYLOGGER
    bool "using easylogger"
    default n

config ENABLE_LINENOISE
    bool "using linenoise"
    default n

endmenu
```

## configs/radar_defconfig
```kconfig
CONFIG_RADAR=y

#
# components
#
CONFIG_ENABLE_FSMOMC=y
CONFIG_ENABLE_CM_BACKTRACE=y
CONFIG_ENABLE_EASYLOGGER=y
CONFIG_ENABLE_LINENOISE=y
# end of components
```
